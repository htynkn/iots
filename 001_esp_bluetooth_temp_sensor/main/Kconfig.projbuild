## 001_esp_bluetooth_temp_sensor/main/Kconfig.projbuild
```kconfig
# BTHome Temperature Sensor Configuration Options

menu "BTHome Temperature Sensor Configuration"
    depends on APPTRACE_ENABLE

config BTHOME_SENSOR_GPIO
    int "GPIO pin for DS18B20 sensor"
    default 4
    help
      GPIO pin to which the DS18B20 sensor is connected

config BTHOME_MEASUREMENT_INTERVAL
    int "Measurement interval in seconds"
    default 180
    help
      Interval between temperature measurements in seconds (default 180 = 3 minutes)

config BTHOME_ENABLE_BATTERY_MONITORING
    bool "Enable battery voltage monitoring"
    default y
    help
      Enable monitoring and reporting of battery voltage

endmenu
```

## 001_esp_bluetooth_temp_sensor/sdkconfig.defaults
```kconfig
# 配置ESP32C2使用26MHz晶振
CONFIG_ESP32_XTAL_FREQ_26=y
# 配置ESP32C2 CPU频率为80MHz (这是基于26MHz晶振的常见配置)
CONFIG_ESP32_DEFAULT_CPU_FREQ_80=y
# 如果需要其他CPU频率，可以取消注释以下选项之一
# CONFIG_ESP32_DEFAULT_CPU_FREQ_120=y
# CONFIG_ESP32_DEFAULT_CPU_FREQ_160=y

# 配置2MB Flash存储
CONFIG_ESPTOOLPY_FLASHSIZE_2MB=y
# 如果需要其他Flash大小，可以取消注释以下选项之一
# CONFIG_ESPTOOLPY_FLASHSIZE_4MB=y
# CONFIG_ESPTOOLPY_FLASHSIZE_8MB=y

# 使用2MB分区表
CONFIG_PARTITION_TABLE_CUSTOM=y
CONFIG_PARTITION_TABLE_FILENAME="partitions_2MB.csv"
```
